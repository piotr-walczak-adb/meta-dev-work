## conf/layer.conf
```bitbake
BBPATH .= ":${LAYERDIR}"
# Recipes and appends:
BBFILES += "\
            ${LAYERDIR}/recipes-*/*/*.bb \
            ${LAYERDIR}/recipes-*/*/*.bbappend \
           "

BBFILE_COLLECTIONS += "dev-work"
BBFILE_PATTERN_dev-work = "^${LAYERDIR}/"
BBFILE_PRIORITY_dev-work = "999"
LAYERVERSION_dev-work = "1"
```
